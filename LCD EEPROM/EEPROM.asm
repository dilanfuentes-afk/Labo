#INCLUDE "P16F887.INC"

	__CONFIG _CONFIG1, (_CP_OFF & _WDT_OFF & _PWRTE_ON & _XT_OSC & _LVP_OFF)	
	__CONFIG _CONFIG2, _BOR21V

	REG1 EQU 0X20
	REG2 EQU 0X21
	REG3 EQU 0X22
	REGADR EQU 0X23
	REGDAT EQU 0X24
	REGAUX EQU 0X25
							ORG 0X00
INICIO
BANKSEL ANSEL
	CLRF ANSEL
	CLRF ANSELH
	BSF ANSEL,0
BANKSEL TRISA
	CLRF TRISE
	CLRF TRISD
	BSF TRISB,0
	BSF TRISB,1
;----------------------------------------------
;-------YENDO A LA CONFIGURACION DEL LCD-------
;----------------------------------------------
BANKSEL PORTA
	CALL LCD_CONFIG
BANKSEL PORTA
	GOTO HOLA
;----------------------------------------------
;------IR AL INICIO DEL PROGRAMA---------------
;------VAYA MANUALMENTE A INICIO---------------
;----------------------------------------------
TABLAASCCIIHEXA
	ADDWF PCL,F
	RETLW '0'
	RETLW '1'
	RETLW '2'
	RETLW '3'
	RETLW '4'
	RETLW '5'
	RETLW '6'
	RETLW '7'
	RETLW '8'
	RETLW '9'	
	RETLW 'A'
	RETLW 'B'
	RETLW 'C'
	RETLW 'D'
	RETLW 'E'
	RETLW 'F'
;**********SWICH1**********
SWICH1
	BTFSC PORTB,0
	GOTO $-.1
	BTFSC REG3,0 ;DETECTAR SI CAMBIO SWICH
	GOTO $+.8;CAMBIAR A ESC
	INCF REG3
	BCF PORTE,0
	BCF PORTE,1
;####MOVER CURSOR#########
	MOVLW B'10000100'
	MOVWF PORTD
	CALL ENABLE
	RETURN
	DECF REG3
	BCF PORTE,0
	BCF PORTE,1
;#######MOVER CURSOR#########
	MOVLW B'10001001'
	MOVWF PORTD
	CALL ENABLE
	RETURN
;-------------------------------------------	
;-----------------INICIO PROGRAMA-----------
;-------------------------------------------
HOLA
	CLRF REGDAT
	CLRF REGADR
	CLRF REGAUX
	CALL SELECCION
CONTINUO
	BTFSC PORTB,0
	CALL SWICH1
	BTFSC PORTB,1
	GOTO SELECT1;SELECT1
	GOTO CONTINUO


;#############LEER O ESCRIBIR#########
SELECT1
	BTFSS REG3,0
	GOTO ESC
	GOTO LEER
;-------------------------------------------
;------------LEER EEPROM--------------------
;-------------------------------------------
LEER
	CALL ESCRIBIR2
ESPERAR
	BCF PORTE,0
	BCF PORTE,1
	MOVLW B'10001011'
	MOVWF PORTD
	CALL ENABLE
	BTFSC PORTB,0
	CALL INCADDR
	BTFSC PORTB,1
	GOTO SELECT2
	GOTO ESPERAR

SELECT2
;------------------------------------------------
;----MOSTRAR QUE DATA HAY EN LA DIRECCION ADDR---
;-----------------------------------------------
	CALL COMANDO5
	CALL FINAL1
	CALL MOSTRAR
	CALL FINAL2
	CALL LEEREEPROM
	CALL MOSTRAR2
	CALL TIEMPO2
	CALL TIEMPO2
	CALL TIEMPO2
	CALL TIEMPO2
	CALL TIEMPO2
	CALL COMANDO5
	GOTO HOLA
;--------------------------------------------
;------volver al inicio del programa---------
;--------------------------------------------
;#####INDICAR EN QUE DIRECCION ESTA######
INCADDR
	BTFSC PORTB,0
	GOTO $-.1
	INCF REGADR
	CALL MOSTRAR
	RETURN
INCDATA
	BTFSC PORTB,0
	GOTO $-.1
	INCF REGDAT
	CALL MOSTRAR2
	RETURN
;**MOSTRAR ADDR**
MOSTRAR								;**
	BSF PORTE,0 ;PARA ESCRIBIR		;
	BCF PORTE,1 ;PARA ESCRIBIR		;
	MOVF REGADR,W					;
	ANDLW 0XF0						;
	MOVWF REGAUX					;
	SWAPF REGAUX,F					;
	MOVF REGAUX,W					;
	CALL TABLAASCCIIHEXA			;
	MOVWF PORTD						;
	CALL ENABLE						;
	MOVF REGADR,W					;
	ANDLW 0X0F						;
	MOVWF REGAUX					;
	MOVF REGAUX,W					;
	CALL TABLAASCCIIHEXA			;
	MOVWF PORTD						;
	CALL ENABLE						;
	RETURN							;**
;**MOSTRAR DATA**
MOSTRAR2							;**
	BSF PORTE,0 ;PARA ESCRIBIR		;
	BCF PORTE,1 ;PARA ESCRIBIR		;
	MOVF REGDAT,W					;
	ANDLW 0XF0						;
	MOVWF REGAUX					;
	SWAPF REGAUX,F					;
	MOVF REGAUX,W					;
	CALL TABLAASCCIIHEXA			;
	MOVWF PORTD						;
	CALL ENABLE						;
	MOVF REGDAT,W					;
	ANDLW 0X0F						;
	MOVWF REGAUX					;
	MOVF REGAUX,W					;
	CALL TABLAASCCIIHEXA			;
	MOVWF PORTD						;
	CALL ENABLE						;
	RETURN							;**
;---------------------------------------	
;------------ESCRIBIR EEPROM------------
;---------------------------------------
ESC
	CALL ESCRIBIR2
ESPERAR2
	BCF PORTE,0
	BCF PORTE,1
	MOVLW B'10001011'
	MOVWF PORTD
	CALL ENABLE
	BTFSC PORTB,0
	CALL INCADDR
	BTFSC PORTB,1
	GOTO CONTINUACION
	GOTO ESPERAR2
CONTINUACION
	CALL ESCRIBIR3
WAITING
	BCF PORTE,0
	BCF PORTE,1
	MOVLW B'10001011'
	MOVWF PORTD
	CALL ENABLE
	BTFSC PORTB,0
	CALL INCDATA
	BTFSC PORTB,1
	GOTO TREE
	GOTO WAITING
;----------------------------------------	
;------------ESCRIBIR YA EN--------------
;------------LA EEPROM-------------------	
;----------------------------------------
TREE
	CALL COMANDO5
	CALL ESCRIBIREEPROM
	CALL FINAL1
	CALL MOSTRAR
	CALL FINAL2
	CALL LEEREEPROM
	CALL MOSTRAR2
	CALL TIEMPO2
	CALL TIEMPO2
	CALL TIEMPO2
	CALL TIEMPO2
	CALL TIEMPO2
	CALL COMANDO5
	GOTO HOLA
;-------------------------------------------
;------volver al inicio del programa---------
;-------------------------------------------
;***********MOSTRAR LA SELECCION***********
SELECCION
	BSF PORTE,0
	BCF PORTE,1
	MOVLW 'L'
	MOVWF PORTD
	CALL ENABLE
	MOVLW 'E'
	MOVWF PORTD
	CALL ENABLE
	MOVLW 'E'
	MOVWF PORTD
	CALL ENABLE
	MOVLW 'R'
	MOVWF PORTD
	CALL ENABLE
	MOVLW '_'
	MOVWF PORTD
	CALL ENABLE
	MOVLW '/'
	MOVWF PORTD
	CALL ENABLE
	MOVLW 'E'
	MOVWF PORTD
	CALL ENABLE
	MOVLW 'S'
	MOVWF PORTD
	CALL ENABLE
	MOVLW 'C'
	MOVWF PORTD
	CALL ENABLE
	MOVLW '_'
	MOVWF PORTD
	CALL ENABLE
	RETURN
;********MOSTRAR SELECCCION ADDR PARA LEER*******	
ESCRIBIR2
	CALL COMANDO4
	BSF PORTE,0
	BCF PORTE,1
	MOVLW 'S'
	MOVWF PORTD
	CALL ENABLE
	MOVLW 'E'
	MOVWF PORTD
	CALL ENABLE
	MOVLW 'L'
	MOVWF PORTD
	CALL ENABLE
	MOVLW 'E'
	MOVWF PORTD
	CALL ENABLE
	MOVLW 'C'
	MOVWF PORTD
	CALL ENABLE
	MOVLW 'T'
	MOVWF PORTD
	CALL ENABLE
	MOVLW ' '
	MOVWF PORTD
	CALL ENABLE
	MOVLW 'A'
	MOVWF PORTD
	CALL ENABLE
	MOVLW 'D'
	MOVWF PORTD
	CALL ENABLE
	MOVLW 'D'
	MOVWF PORTD
	CALL ENABLE
	MOVLW 'D'
	MOVWF PORTD
	CALL ENABLE
	MOVLW '0'
	MOVWF PORTD
	CALL ENABLE
	MOVLW '0'
	MOVWF PORTD
	CALL ENABLE
	RETURN
;******MOSTRAR SELECCCION DATA PARA ESCRIBIR******
ESCRIBIR3
	CALL COMANDO4
	BSF PORTE,0
	BCF PORTE,1
	MOVLW 'S'
	MOVWF PORTD
	CALL ENABLE
	MOVLW 'E'
	MOVWF PORTD
	CALL ENABLE
	MOVLW 'L'
	MOVWF PORTD
	CALL ENABLE
	MOVLW 'E'
	MOVWF PORTD
	CALL ENABLE
	MOVLW 'C'
	MOVWF PORTD
	CALL ENABLE
	MOVLW 'T'
	MOVWF PORTD
	CALL ENABLE
	MOVLW ' '
	MOVWF PORTD
	CALL ENABLE
	MOVLW 'D'
	MOVWF PORTD
	CALL ENABLE
	MOVLW 'A'
	MOVWF PORTD
	CALL ENABLE
	MOVLW 'T'
	MOVWF PORTD
	CALL ENABLE
	MOVLW 'A'
	MOVWF PORTD
	CALL ENABLE
	MOVLW '0'
	MOVWF PORTD
	CALL ENABLE
	MOVLW '0'
	MOVWF PORTD
	CALL ENABLE
	RETURN	
;********MOSTRAR FINAL1*******
FINAL1
	BSF PORTE,0 			;**
	BCF PORTE,1				;
	MOVLW 'A'				;
	MOVWF PORTD				;
	CALL ENABLE				;
	MOVLW 'D'				;
	MOVWF PORTD				;
	CALL ENABLE				;
	MOVLW 'D'				;
	MOVWF PORTD				;
	CALL ENABLE				;
	MOVLW 'R'				;
	MOVWF PORTD				;
	CALL ENABLE				;	
	RETURN					;**
	
;*********MOSTRRAR FINAL2******
FINAL2						;**
	BSF PORTE,0				;
	BCF PORTE,1				;
	MOVLW 'D'				;
	MOVWF PORTD				;
	CALL ENABLE				;
	MOVLW 'A'				;
	MOVWF PORTD				;
	CALL ENABLE				;
	MOVLW 'T'				;
	MOVWF PORTD				;
	CALL ENABLE				;
	MOVLW 'A'				;
	MOVWF PORTD				;
	CALL ENABLE				;
	RETURN					;**
;---------------------------------------------
;---------configuracion del LCD---------------
;---------------------------------------------
LCD_CONFIG
	BCF PORTE,0
	BCF PORTE,1
COMANDO3 ;######MODO ENTRADA CARACTERES#####
	MOVLW B'00000110'
	MOVWF PORTD
	CALL ENABLE
COMANDO2 ;########APAGADO ENCENDIDO PANTALLA######
	MOVLW B'00001111'
	MOVWF PORTD
	CALL ENABLE
COMANDO1 ;#############FUNCION SET##########
	MOVLW B'00111100'
	MOVWF PORTD
	CALL ENABLE
	RETURN
COMANDO4 ;######CURSOR HOME#####
	BCF PORTE,0
	BCF PORTE,1
	MOVLW B'00000010'
	MOVWF PORTD
	CALL ENABLE
	RETURN
COMANDO5 ;####BORRADO DE PANTALLA
	BCF PORTE,0
	BCF PORTE,1
	MOVLW B'00000001'
	MOVWF PORTD
	CALL ENABLE
	RETURN	

;-------------------------------------------------
;---------------habilitador del LCD---------------
;---------------POR SI ACASO SE MENCIONA----------
;-------------------------------------------------
ENABLE
	BSF PORTE,2
	CALL TIEMPO
	BCF PORTE,2
	RETURN	
;**SUBRUTINA DE TIEMPO**
TIEMPO						;**
	MOVLW .25				;
	MOVWF REG1				;
PORTAL						;
	MOVLW .255				;
	MOVWF REG2				;
UNOS						;
	DECFSZ REG2,1			;
	GOTO UNOS				;
	DECFSZ REG1,1			;
	GOTO PORTAL				;
	NOP						;
	NOP						;
	NOP						;
	RETURN					;**
	;**SUBRUTINA DE TIEMPO2**
TIEMPO2
	CLRF REG3				;**
	MOVLW .5				;
	MOVWF REG1				;
	MOVLW .255				;
	MOVWF REG2				;
	MOVLW .255				;
	MOVWF REG3				;
	DECFSZ REG3,1			;
	GOTO $-.1				;
	DECFSZ REG2,1			;
	GOTO $-.5				;
	DECFSZ REG1,1			;
	GOTO $-.7				;
	NOP						;
	NOP						;
	NOP						;
	RETURN					;**
;-----------------------------------------------
;-----------COMANDO--LEER-EEPROM----------------
;-----------POR SI ACASO SE NECESITA------------
;-----------------------------------------------
LEEREEPROM
BANKSEL PORTA
	MOVF REGADR,W
BANKSEL EEADR
	MOVWF EEADR
BANKSEL EECON1
	BCF EECON1,EEPGD
	BSF EECON1,RD
BANKSEL EEDATA
	MOVF EEDATA,W
BANKSEL PORTA
	MOVWF REGDAT
	RETURN

;-----------------------------------------------
;----------COMANDO--ESCRIBIR-EEPROM-------------
;----------POR SI ACASO SE NECESITA-------------
;-----------------------------------------------
ESCRIBIREEPROM
BANKSEL PORTA
	MOVF REGDAT,W
BANKSEL EEDATA
	MOVWF EEDATA
BANKSEL PORTA
	MOVF REGADR,W
BANKSEL EEDATA
	MOVWF EEADR
;######HABER MOVIDO LOS GPR A DATOS Y DIRECCION##
BANKSEL EECON1
	BCF EECON1,EEPGD
	BSF EECON1,WREN
	MOVLW 0X55
	MOVWF EECON2
	MOVLW 0XAA
	MOVWF EECON2
	BSF EECON1,WR
	BCF EECON1,WREN
BANKSEL PORTA
	RETURN
	
END