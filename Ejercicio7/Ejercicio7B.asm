#INCLUDE "P16F887.INC"
	
	__CONFIG _CONFIG1,(_CP_OFF & _WDT_OFF & _PWRTE_ON & _XT_OSC & _LVP_OFF)
	__CONFIG _CONFIG2, _BOR21V

DCounter1 EQU 0X0C
DCounter2 EQU 0X0D
REGU EQU 0X23
REGD EQU 0X24
REGC EQU 0X25
REGM EQU 0X26
REGSL EQU 0X27
REGSH EQU 0X28



				
				
				ORG 0X00
GOTO SALTO
TABLA:
	ADDWF PCL,F
	RETLW '0'
	RETLW '1'
	RETLW '2'
	RETLW '3'
	RETLW '4'
	RETLW '5'
	RETLW '6'
	RETLW '7'
	RETLW '8'
	RETLW '9'
SALTO
;#################Anulamos las entradas analogicas menos la AN0
BANKSEL ANSEL 
	CLRF ANSELH
	CLRF ANSEL
	BSF ANSEL,0
;##########Configuramos los Pines como salidas, menos el pin 0 de tris a (AN0)
BANKSEL TRISA
	CLRF TRISA
	BSF TRISA,0
	CLRF TRISE
	CLRF TRISD

;######################Configuramos ADCON0 y ADCON1
BANKSEL ADCON0
	MOVLW B'01000001';Fosc 8,adon
	MOVWF ADCON0

BANKSEL ADCON1
	CLRF ADCON1
	BSF ADCON1,7;JUSTIFICACION DERECHA 
GOTO  INICIO
;=========================================================
LCD_CONFIG
	BCF PORTE,0	;AS EN 0 PARA COMANDO
	BCF PORTE,1 ;AW EN 1 PARA ESCRIBIR 

COMANDOS3 ; IN OUT CHARACTER 
	MOVLW B'00000110'
	MOVWF PORTD
	CALL ENABLE

COMANDOS2 ; ON-OFF
	MOVLW B'00001100'
	MOVWF PORTD
	CALL ENABLE

COMANDOS1
	MOVLW B'00111100'
	MOVWF PORTD
	CALL ENABLE
	RETURN
;========================================================
INICIO;############### ORDEN DE EJECUCION DE PROCESOS
	BSF ADCON0,1;GO/DONE
	BTFSC ADCON0,1
	GOTO $-.1
	CALL MAPE
	CALL DESCOMP
	CALL REVCAS
	CALL ARREGLO
	CALL LCD_CONFIG
	CALL ESCRIBIR
	
GOTO INICIO


;###################CARGO LOS VALORES DE ADRESL Y ADRESH EN GPR#####
MAPE
	CLRF REGSL
	CLRF REGSH
	
	BANKSEL ADRESL
	MOVF ADRESL,W
	BANKSEL PORTC
	MOVWF REGSL

	BANKSEL ADRESH
	MOVF ADRESH,W
	BANKSEL PORTD
	MOVWF REGSH

RETURN
;#####################Descompongo#############
DESCOMP
	CLRF REGC
	CLRF REGD
	CLRF REGU
	CLRF REGM

CENTENA	
	MOVLW .100
	SUBWF REGSL,F
	BTFSC STATUS,C
	GOTO $+.3
	ADDWF REGSL
	GOTO DECENA
	INCF REGC,F
	GOTO $-.6

DECENA
	MOVLW .10
	SUBWF REGSL,F
	BTFSC STATUS,C
	GOTO $+.3
	ADDWF REGSL
	GOTO UNIDAD
	INCF REGD,F
	GOTO $-.6

UNIDAD
	MOVLW .1
	SUBWF REGSL,F
	BTFSC STATUS,C
	GOTO $+.3
	ADDWF REGSL
	RETURN
	INCF REGU,F
	GOTO $-.6

;############### REVISO CASOS ###########
REVCAS
	MOVLW .0
	XORWF REGSH,W ;PREGUNTO "REGSH == 0?"
	BTFSC STATUS,Z;EN CASO DE SER IGUALES ENTRA EN CAS0
	GOTO CAS0
	
	MOVLW .1
	XORWF REGSH,W
	BTFSC STATUS,Z
	GOTO CAS1

	MOVLW .2
	XORWF REGSH,W
	BTFSC STATUS,Z
	GOTO CAS2
	
	MOVLW .3
	XORWF REGSH,W
	BTFSC STATUS,Z
	GOTO CAS3
RETURN
		
;################# CASOS DE REGSH ##########	
;####  sumo las literales correspondientes en los Ru Rd Rc 
CAS0

	MOVLW .0
	ADDWF REGU,F

	MOVLW .0
	ADDWF REGD,F

	MOVLW .0
	ADDWF REGC,F

RETURN

CAS1
	MOVLW .6
	ADDWF REGU,F

	MOVLW .5
	ADDWF REGD,F

	MOVLW .2
	ADDWF REGC,F

RETURN

CAS2
	MOVLW .2
	ADDWF REGU,F

	MOVLW .1
	ADDWF REGD,F

	MOVLW .5
	ADDWF REGC,F

RETURN

CAS3
	MOVLW .8
	ADDWF REGU,F

	MOVLW .6
	ADDWF REGD,F

	MOVLW .7
	ADDWF REGC,F

RETURN 
;##################### REPARO VALORES < 9 #########
ARREGLO
	MOVLW .246 ;cargo el acumulador para carry si se le suma =< 10
	ADDWF REGU,W;sumo el contenido del registro al acumulador
	BTFSC STATUS,C;pregunto si ocurre acarreo, si ocurre, call correxu
	CALL CORREXU
	
	MOVLW .246
	ADDWF REGD,W
	BTFSC STATUS,C
	CALL CORREXD
	
	MOVLW .246
	ADDWF REGC,W
	BTFSC STATUS,C
	CALL CORREXC
	
RETURN

;###################### CORRECTORES
;## muevo 10 al acumulador y proximamente le resto la literal al registro registro
;## remplazo el valor del registro con el resultado de la resta 
;## Cargo la literal "1" al workfile y la sumo al registro siguiente
CORREXU
	MOVLW .10
	SUBWF REGU,F
	MOVLW .1
	ADDWF REGD,F
RETURN

CORREXD
	MOVLW .10
	SUBWF REGD,F
	MOVLW .1
	ADDWF REGC,F
RETURN

CORREXC
	MOVLW .10
	SUBWF REGC,F
	MOVLW .1
	ADDWF REGM,F ;Aсade 1 al RegMillares
RETURN
 ;########################ESCRIBIR
ESCRIBIR
	BSF PORTE,0
	BCF PORTE,1

	MOVF REGM,W
	CALL TABLA
	MOVWF PORTD
	CALL ENABLE

	MOVF REGC,W
	CALL TABLA
	MOVWF PORTD
	CALL ENABLE

	MOVF REGD,W
	CALL TABLA
	MOVWF PORTD
	CALL ENABLE

	MOVF REGU,W
	CALL TABLA
	MOVWF PORTD
	CALL ENABLE

	BCF PORTE,0
	BCF PORTE,1
	

	MOVLW B'00000010'
	MOVWF PORTD
	CALL ENABLE

	RETURN

ENABLE
	BSF PORTE,2
	CALL TIEMPO1
	BCF PORTE,2
	RETURN
;##########################################
TIEMPO1 ; 4 mili-segundos
MOVLW 0X2f
MOVWF DCounter1
MOVLW 0X06
MOVWF DCounter2
LOOP
DECFSZ DCounter1, 1
GOTO LOOP
DECFSZ DCounter2, 1
GOTO LOOP
RETURN
END
