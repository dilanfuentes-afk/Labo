#INCLUDE "P16F887.INC"

	__CONFIG _CONFIG1, (_CP_OFF & _WDT_OFF & _PWRTE_ON & _XT_OSC & _LVP_OFF)
	__CONFIG _CONFIG2, _BOR21V

Reg1 EQU 0x20
Reg2 EQU 0x21
Reg3 EQU 0x22

ORG 0X00

BANKSEL ANSEL
CLRF ANSEL
CLRF ANSELH

Inicio
	BANKSEL TRISA
	CLRF TRISA
	CLRF TRISB

	BANKSEL PORTA

	BSF PORTA,0
	BSF PORTA,3
	
	MOVLW B'01111110'
	MOVWF PORTB
	CALL Tiempo

	MOVLW B'00110000'
	MOVWF PORTB
	CALL Tiempo
	
	MOVLW B'01101101'
	MOVWF PORTB
	CALL Tiempo
	
	MOVLW B'01111001'
	MOVWF PORTB
	CALL Tiempo
	
	MOVLW B'00110011'
	MOVWF PORTB
	CALL Tiempo
	
	MOVLW B'01011011'
	MOVWF PORTB
	CALL Tiempo
	
	MOVLW B'01011111'
	MOVWF PORTB
	CALL Tiempo
	
	MOVLW B'01110000'
	MOVWF PORTB
	CALL Tiempo
	
	MOVLW B'01111111'
	MOVWF PORTB
	CALL Tiempo
	
	MOVLW B'01110011'
	MOVWF PORTB
	CALL Tiempo
	
	GOTO Inicio

Tiempo
	MOVLW .255
	MOVWF Reg1

Sigo
	MOVLW .255
	MOVWF Reg2

Uno
	MOVLW .5
	MOVWF Reg3

Dos
	DECFSZ Reg3,1
	GOTO Dos
	DECFSZ Reg2,1
	GOTO Uno
	DECFSZ Reg1,1
	GOTO Sigo
	Return

END
