#INCLUDE "P16F887.INC"

    __CONFIG _CONFIG1, (_CP_OFF & _WDT_OFF & _PWRTE_ON & _XT_OSC & _LVP_OFF)
    __CONFIG _CONFIG2, _BOR21V

	

PDel0 EQU 0X29  
PDel1 EQU 0X2A  
PDel2 EQU 0X2B
REGINC EQU 0x30      ; Registro que guarda la direcciСn seleccionada
REGAUX EQU 0x31 


	ORG 0X00

GOTO CON

TABLA_HEXA

	ADDWF PCL,1
	RETLW '0'
	RETLW '1'
	RETLW '2'
	RETLW '3'
	RETLW '4'
	RETLW '5'
	RETLW '6'
	RETLW '7'
	RETLW '8'
	RETLW '9'
	RETLW 'A'
	RETLW 'B'
	RETLW 'C'
	RETLW 'D'
	RETLW 'E'
	RETLW 'F'

TABLA_HEXA2

	ADDWF PCL,1
	RETLW '0'
	RETLW '1'
	RETLW '2'
	RETLW '3'
	RETLW '4'
	RETLW '5'
	RETLW '6'
	RETLW '7'
	RETLW '8'
	RETLW '9'
	RETLW 'A'
	RETLW 'B'
	RETLW 'C'
	RETLW 'D'
	RETLW 'E'
	RETLW 'F'

CON
	BANKSEL ANSEL
	CLRF ANSEL
	CLRF ANSELH
	
	BANKSEL TRISB
	CLRF TRISD
	CLRF TRISE
	MOVLW B'00000011'
	MOVWF TRISB
	
	BANKSEL PORTA
	CLRF PORTB
	CLRF PORTD
	CLRF PORTE

	CALL LCD_CONFIG
	CLRF REGINC      ; Inicia direcciСn en 0x00

	GOTO INICIO

;=== CONFIGURACION LDC ===
LCD_CONFIG
	BCF PORTE,0
	BCF PORTE,1

COMANDO3
	MOVLW B'00000110'
	MOVWF PORTD
	CALL ENABLE
COMANDO2
    MOVLW B'00001111' ; display ON, cursor ON, blink ON
	MOVWF PORTD
	CALL ENABLE
COMANDO1
	MOVLW B'00111100'
	MOVWF PORTD
	CALL ENABLE
	RETURN

;===ENABLE===
ENABLE 
	BSF PORTE,2
	CALL TIEMPO
	BCF PORTE,2
	RETURN


ENVIAR_COMANDO
    BCF PORTE,0      ; RS = 0 ? comando
    BCF PORTE,1      ; RW = 0 ? escritura
    MOVWF PORTD      ; W contiene el comando
    CALL ENABLE
    RETURN

INICIO

PANTALLA1
	BSF PORTE,0
	BCF PORTE,1

	MOVLW 'L'
	MOVWF PORTD
	CALL ENABLE

	MOVLW 'E'
	MOVWF PORTD
	CALL ENABLE

	MOVLW 'E'
	MOVWF PORTD
	CALL ENABLE
	
	MOVLW 'R'
	MOVWF PORTD
	CALL ENABLE

	MOVLW '_'
	MOVWF PORTD
	CALL ENABLE

	MOVLW '/'
	MOVWF PORTD
	CALL ENABLE

	MOVLW 'E'
	MOVWF PORTD
	CALL ENABLE

	MOVLW 'S'
	MOVWF PORTD
	CALL ENABLE

	MOVLW 'C'
	MOVWF PORTD
	CALL ENABLE

	MOVLW '_'
	MOVWF PORTD
	CALL ENABLE

	MOVLW ' '
	MOVWF PORTD
	CALL ENABLE

	MOVLW ' '
	MOVWF PORTD
	CALL ENABLE

	MOVLW B'00000001'
	MOVWF PORTD
	CALL ENABLE


; === LECTURA DE BOTON EN PORTB,0 ===
LCD1
    BTFSS PORTB,0      ; Si estА en 1, salta
    GOTO POS_LEER   

POS_ESC:
    MOVLW 0x09         ; POSICIсN 9
    CALL MOVER_CURSOR
	GOTO MANTENERSE

POS_LEER:
    MOVLW 0x04         ; POSICIсN 4
	CALL MOVER_CURSOR
	GOTO MANTENERSE2

MOVER_CURSOR:
    IORLW 0x80         ; Set DDRAM Address (bit 7 = 1)
    CALL ENVIAR_COMANDO
	RETURN

;===MANTENER===
MANTENERSE
	BTFSC PORTB,0
	GOTO POS_LEER
	GOTO CHECK1

MANTENERSE2
	BTFSC PORTB,0
	GOTO POS_ESC
	GOTO CHECK2
;===MANTENER===

;===CHECKEO B1===
CHECK1
	BTFSC PORTB,1

	GOTO MANTENERSE

CHECK2
	BTFSC PORTB,1
	GOTO PANTALLA_LEER
	GOTO MANTENERSE2
;===CHECKEO B1===


PANTALLA_LEER

	MOVLW B'00000001'
	MOVWF PORTD
	CALL ENABLE

	BSF PORTE,0
	BCF PORTE,1

	MOVLW 'S'
	MOVWF PORTD
	CALL ENABLE

	MOVLW 'E'
	MOVWF PORTD
	CALL ENABLE

	MOVLW 'L'
	MOVWF PORTD
	CALL ENABLE
	
	MOVLW 'E'
	MOVWF PORTD
	CALL ENABLE

	MOVLW 'C'
	MOVWF PORTD
	CALL ENABLE

	MOVLW 'T'
	MOVWF PORTD
	CALL ENABLE

	MOVLW ' '
	MOVWF PORTD
	CALL ENABLE

	MOVLW 'A'
	MOVWF PORTD
	CALL ENABLE

	MOVLW 'D'
	MOVWF PORTD
	CALL ENABLE

	MOVLW 'D'
	MOVWF PORTD
	CALL ENABLE

	MOVLW 'R'
	MOVWF PORTD
	CALL ENABLE

	MOVLW ''
	MOVWF PORTD
	CALL ENABLE

	MOVLW '_'
	MOVWF PORTD
	CALL ENABLE

	MOVLW '_'
	MOVWF PORTD
	CALL ENABLE

	MOVLW ' '
	MOVWF PORTD
	CALL ENABLE

	MOVLW ' '
	MOVWF PORTD
	CALL ENABLE

	MOVLW B'00000001'
	MOVWF PORTD
	CALL ENABLE

CUSTOM 
	SWAPF DATA_EE_ADR,W
	MOVWF

	
	










TIEMPO      
        movlw     .197      ; 1 set numero de repeticion  (B)
        movwf     PDel0     ; 1 |
PLoop1  movlw     .253      ; 1 set numero de repeticion  (A)
        movwf     PDel1     ; 1 |
PLoop2  clrwdt              ; 1 clear watchdog
        clrwdt              ; 1 ciclo delay
        decfsz    PDel1, 1  ; 1 + (1) es el tiempo 0  ? (A)
        goto      PLoop2    ; 2 no, loop
        decfsz    PDel0,  1 ; 1 + (1) es el tiempo 0  ? (B)
        goto      PLoop1    ; 2 no, loop
PDelL1  goto PDelL2         ; 2 ciclos delay
PDelL2  
        return              ; 2+2 Fin.


	END