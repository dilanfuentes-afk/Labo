#INCLUDE "P16F887.INC"
	
__CONFIG _CONFIG1,(_CP_OFF & _WDT_OFF & _PWRTE_ON & _XT_OSC & _LVP_OFF)
__CONFIG _CONFIG2, _BOR21V

DCounter1 EQU 0X0C
DCounter2 EQU 0X0D
RUU EQU 0X20
RDD EQU 0X21
TEMP EQU 0X22
RESL EQU 0X24

ORG 0X00
BANKSEL ANSEL 
	CLRF ANSELH
	CLRF ANSEL
	BSF ANSEL,0

BANKSEL TRISA
	CLRF TRISA
	BSF TRISA,0
	CLRF TRISE
	CLRF TRISD
;============================================================================
BANKSEL ADCON0
	MOVLW B'01000001';Fosc 8,adon
	MOVWF ADCON0

BANKSEL ADCON1
	CLRF ADCON1
	BSF ADCON1,7;JUSTIFICACION DERECHA 
GOTO  INICIO
;============================================================================
	CLRF RESL
	
	BANKSEL ADRESL
	MOVF ADRESL,W
	BANKSEL PORTC
	MOVWF RESL
;============================================================================
CONFIGURO
	BCF PORTE,0	;AS EN 0 PARA COMANDO
	BCF PORTE,1 ;AW EN 1 PARA ESCRIBIR 

COMANDOS3 ; IN OUT CHARACTER 
	MOVLW B'00000110'
	MOVWF PORTD
	CALL ENABLE

COMANDOS2 ; ON-OFF
	MOVLW B'00001100'
	MOVWF PORTD
	CALL ENABLE

COMANDOS1
	MOVLW B'00111100'
	MOVWF PORTD
	CALL ENABLE
	RETURN
;============================================================================
INICIO
	CALL CONFIGURO

PREGUNTAVALOR
	CLRF TEMP
	CLRF RUU
	CLRF RDD
	CALL CONVERTIR
	
	MOVF RESL,W
	XORLW .102
	BTFSS STATUS,Z
	GOTO P2
	GOTO CERO

P2
	MOVLW .102
	SUBWF RESL,W
	BTFSC STATUS,C
	GOTO POSITIVO
	GOTO NEGATIVO

CERO
	MOVLW .0
	MOVWF RUU
	GOTO MOSTRARCERO

POSITIVO 
	MOVLW .112
	SUBWF RESL,W
	BTFSC STATUS,C
	GOTO $+.2
	GOTO DECREMENTO
	MOVLW .157
	SUBWF RESL,W
	BTFSC STATUS,C
	GOTO $+.2
	GOTO RESTAR
	MOVLW .200
	SUBWF RESL,W
	BTFSC STATUS,C
	GOTO $+.2
	GOTO RESTA2
	MOVLW .206
	SUBWF RESL,W
	BTFSC STATUS,C
	GOTO FUERADETERMINO

	DECF RESL,1
RESTA2
	DECF RESL,1
RESTAR
	DECF RESL,1

DECREMENTO
	MOVLW .2
	SUBWF RESL,1
	INCF TEMP,1
	MOVF RESL,W
	XORLW .102
	BTFSS STATUS,Z
	GOTO DECREMENTO
	CALL DESCOMPONER 
	GOTO MOSTRARPOSITIVO

NEGATIVO 
	MOVLW .82
	SUBWF RESL,W
	BTFSC STATUS,C
	GOTO $+.2
	GOTO FUERADETERMINO
	MOVLW .2
	ADDWF RESL,1
	INCF TEMP,1
	MOVF RESL,W
	XORLW .102
	BTFSS STATUS,Z
	GOTO NEGATIVO
	CALL DESCOMPONER
	GOTO MOSTRARNEGATIVO

MOSTRARNEGATIVO
	MOVLW '-'
	MOVWF PORTD
	CALL ENABLE

MOSTRARPOSITIVO
	MOVF RDD,W
	XORLW .0
	BTFSS STATUS,Z
	GOTO $+.2
	GOTO $+.5
	MOVF RDD,W
	CALL TABLAASC
	MOVWF PORTD
	CALL ENABLE

MOSTRARCERO
	MOVF RUU,W
	CALL TABLAASC
	MOVWF PORTD
	CALL ENABLE
	
	MOVLW B'11011111' ;BINARIO (0)
	MOVWF PORTD
	CALL ENABLE

	MOVLW 'C'
	MOVWF PORTD
	CALL ENABLE
	CALL TIEMPO
	CALL LIMPIARPANT
	GOTO PREGUNTAVALOR

DESCOMPONER
	CLRF REGC
	CLRF REGD
	CLRF REGU
	CLRF REGM

DECENA
	MOVLW .10
	SUBWF RESL,F
	BTFSC STATUS,C
	GOTO $+.3
	ADDWF RESL
	GOTO UNIDAD
	INCF RDD,F
	GOTO $-.6

UNIDAD
	MOVLW .1
	SUBWF RESL,F
	BTFSC STATUS,C
	GOTO $+.3
	ADDWF RESL
	RETURN
	INCF RUU,F
	GOTO $-.6

FUERADETERMINO
	BSF PORTE,0
	BCF PORTE,1

	MOVLW 'F'
	MOVWF PORTD
	CALL ENABLE

	MOVLW 'U'
	MOVWF PORTD
	CALL ENABLE

	MOVLW 'E'
	MOVWF PORTD
	CALL ENABLE

	MOVLW 'R'
	MOVWF PORTD
	CALL ENABLE

	MOVLW 'A'
	MOVWF PORTD
	CALL ENABLE

	MOVLW ''
	MOVWF PORTD
	CALL ENABLE

	MOVLW 'D'
	MOVWF PORTD
	CALL ENABLE

	MOVLW 'E'
	MOVWF PORTD
	CALL ENABLE

	MOVLW ''
	MOVWF PORTD
	CALL ENABLE

	MOVLW 'R'
	MOVWF PORTD
	CALL ENABLE

	MOVLW 'A'
	MOVWF PORTD
	CALL ENABLE

	MOVLW 'N'
	MOVWF PORTD
	CALL ENABLE

	MOVLW 'G'
	MOVWF PORTD
	CALL ENABLE

	MOVLW 'O'
	MOVWF PORTD
	CALL ENABLE

	RETURN

LIMPIARPANT

	BCF PORTE,0
	BCF PORTE,1
	
	MOVLW B'00000001'
	MOVWF PORTD
	CALL ENABLE
	RETURN

ENABLE
	BSF PORTE,2
	CALL TIEMPO1
	BCF PORTE,2
	RETURN

TIEMPO ; 4 mili-segundos
MOVLW 0X2f
MOVWF DCounter1
MOVLW 0X06
MOVWF DCounter2
LOOP
DECFSZ DCounter1, 1
GOTO LOOP
DECFSZ DCounter2, 1
GOTO LOOP
RETURN
	END 