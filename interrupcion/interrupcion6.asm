#INCLUDE "P16F887.INC"

    __CONFIG _CONFIG1, (_CP_OFF & _WDT_OFF & _PWRTE_ON & _XT_OSC & _LVP_OFF)
    __CONFIG _CONFIG2, _BOR21V

PDel0 EQU 0x25
PDel1 EQU 0x26
REG5 EQU 0X28

ORG 0X00
	GOTO INICIO
;=========INTERRUPCION=========
ORG 0X04
INTER
GOTO PREGUNTA

RESETEAR
	CLRF PORTB
	BCF INTCON,0

PREGUNTA
	BTFSS PORTB,0
	GOTO FILA1
	BTFSS PORTB,1
	GOTO FILA2
	BTFSS PORTB,2
	GOTO FILA3
	BTFSS PORTB,3
	GOTO FILA4
	GOTO RESETEAR

FILA1
	BSF PORTB,4	
	BCF PORTB,5
	BCF PORTB,6
	BTFSC PORTB,0
	GOTO UNO

	BCF PORTB,4	
	BSF PORTB,5
	BCF PORTB,6
	BTFSC PORTB,0
	GOTO DOS

	BCF PORTB,4	
	BCF PORTB,5
	BSF PORTB,6
	BTFSC PORTB,0
	GOTO TRES

	GOTO FILA1

FILA2
	BSF PORTB,4	
	BCF PORTB,5
	BCF PORTB,6
	BTFSC PORTB,1
	GOTO CUATRO

	BCF PORTB,4	
	BSF PORTB,5
	BCF PORTB,6
	BTFSC PORTB,1
	GOTO CINCO

	BCF PORTB,4	
	BCF PORTB,5
	BSF PORTB,6
	BTFSC PORTB,1
	GOTO SEIS

	GOTO FILA2

FILA3
	BSF PORTB,4	
	BCF PORTB,5
	BCF PORTB,6
	BTFSC PORTB,2
	GOTO SIETE

	BCF PORTB,4	
	BSF PORTB,5
	BCF PORTB,6
	BTFSC PORTB,2
	GOTO OCHO

	BCF PORTB,4	
	BCF PORTB,5
	BSF PORTB,6
	BTFSC PORTB,2
	GOTO NUEVE

	GOTO FILA3

FILA4
	BSF PORTB,4	
	BCF PORTB,5
	BCF PORTB,6
	BTFSC PORTB,3
	GOTO AA

	BCF PORTB,4	
	BSF PORTB,5
	BCF PORTB,6
	BTFSC PORTB,3
	GOTO CERO

	BCF PORTB,4	
	BCF PORTB,5
	BSF PORTB,6
	BTFSC PORTB,3
	GOTO BB

	GOTO FILA4

UNO
	MOVLW B'1110'
	MOVWF PORTD
	CALL TIEMPO
	GOTO RESETEAR

DOS
	MOVLW B'0001'
	MOVWF PORTD
	CALL TIEMPO
	GOTO RESETEAR

TRES
	MOVLW B'1001'
	MOVWF PORTD
	CALL TIEMPO
	GOTO RESETEAR

CUATRO
	MOVLW B'0010'
	MOVWF PORTD
	CALL TIEMPO
	GOTO RESETEAR

CINCO
	MOVLW B'1010'
	MOVWF PORTD
	CALL TIEMPO
	GOTO RESETEAR

SEIS
	MOVLW B'0110'
	MOVWF PORTD
	CALL TIEMPO
	GOTO RESETEAR

SIETE
	MOVLW B'1000'
	MOVWF PORTD
	CALL TIEMPO
	GOTO RESETEAR

OCHO
	MOVLW B'0100'
	MOVWF PORTD
	CALL TIEMPO
	GOTO RESETEAR

NUEVE
	MOVLW B'1100'
	MOVWF PORTD
	CALL TIEMPO
	GOTO RESETEAR

AA
	MOVLW B'0101'
	MOVWF PORTD
	CALL TIEMPO
	GOTO RESETEAR

CERO
	MOVLW B'0000'
	MOVWF PORTD
	CALL TIEMPO
	GOTO RESETEAR

BB
	MOVLW B'0001'
	MOVWF PORTD
	CALL TIEMPO
	GOTO RESETEAR

;=== ======INICIALIZACION==========
INICIO
	BANKSEL ANSEL
	CLRF ANSEL
	CLRF ANSELH

	BANKSEL PORTB
	CLRF PORTB
	CLRF PORTD

	BANKSEL TRISD
	MOVLW 0X0F
	MOVWF TRISB
	CLRF TRISD
	BCF OPTION_REG,7
	MOVLW B'00001111'
	MOVWF WPUB
	MOVLW 0X0F
	MOVWF IOCB

	BANKSEL PORTD
	BSF INTCON,0
	BSF INTCON,3
	BSF INTCON,7
	
BUCLE
	NOP
	GOTO BUCLE
 
TIEMPO
    movlw     .239
    movwf     PDel0
PLoop1
    movlw     .232
    movwf     PDel1
PLoop2
    clrwdt
PDelL1
    goto PDelL2
PDelL2
    goto PDelL3
PDelL3
    clrwdt
    decfsz     PDel1, 1
    goto      PLoop2
    decfsz     PDel0, 1
    goto      PLoop1
PDelL4
    goto PDelL5
PDelL5
    goto PDelL6
PDelL6
    goto PDelL7
PDelL7
    clrwdt
    return
    END